## conf/distro/boot2efl.conf
```bitbake
# Copyright (C) 2015 Florent Revest <revestflo@gmail.com>
# Copyright (C) 2015-2016 Nicolas Aguirre <nicolas.aguirre@openwide.fr>
#
# This program is free software; you can redistribute it and/or modify
# it under the terms of the GNU General Public License version 2 as
# published by the Free Software Foundation.
#
# This program is distributed in the hope that it will be useful,
# but WITHOUT ANY WARRANTY; without even the implied warranty of
# MERCHANTABILITY or FITNESS FOR A PARTICULAR PURPOSE.  See the
# GNU General Public License for more details.
#
# You should have received a copy of the GNU General Public License along
# with this program; if not, write to the Free Software Foundation, Inc.,
# 51 Franklin Street, Fifth Floor, Boston, MA 02110-1301 USA.

MAINTAINER = "Nicolas Aguirre <nicolas.aguirre@openwide.fr"

# Distro setup
DISTRO = "boot2efl"
DISTRO_NAME = "Boot 2 EFL"
DISTRO_VERSION ?= "${DATE}-snapshot"

DISTRO_FEATURES = "${DISTRO_FEATURES_LIBC} wayland systemd alsa ipv4 phone usbgadget bluetooth wifi 3g nfc ipv6 zeroconf bluez5 pulseaudio"

PREFERRED_PROVIDER_jpeg = "libjpeg-turbo"
PREFERRED_PROVIDER_jpeg-native = "libjpeg-turbo-native"

VIRTUAL-RUNTIME_init_manager = "systemd"
DISTRO_FEATURES_BACKFILL_CONSIDERED = "sysvinit"
VIRTUAL-RUNTIME_initscripts = "systemd-compat-units"
PREFERRED_PROVIDER_udev = "systemd"

PREFERRED_VERSION_efl = "git"
PREFERRED_VERSION_elementary = "git"
PREFERRED_VERSION_expedite = "git"
PREFERRED_VERSION_e-wm = "git"
PREFERRED_VERSION_ofono = "git"
```
